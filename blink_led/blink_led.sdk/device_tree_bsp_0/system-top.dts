/*
 * CAUTION: This file is automatically generated by Xilinx.
 * Version: XSCT 2019.1
 * Today is: Mon Apr  3 09:13:50 2023
 */

/dts-v1/;
#include "zynq-7000.dtsi"
#include "pcw.dtsi"
/ {
	model = "Development ZedBoard by Gradien 129";
	
	chosen {
		bootargs = "earlycon";
		stdout-path = "serial0:115200n8";
	};
	aliases {
		ethernet0 = &gem0;
		serial0 = &uart1;
		spi0 = &qspi;
	};
	memory {
		device_type = "memory";
		reg = <0x0 0x20000000>;
	};
};
